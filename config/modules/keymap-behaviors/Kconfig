## config/modules/keymap-behaviors/Kconfig
```kconfig
DT_COMPAT_ZMK_BEHAVIOR_LAYER_TRANSITION := zmk,behavior-layer-transition

config ZMK_BEHAVIOR_LAYER_TRANSITION
    bool
    default $(dt_compat_enabled,$(DT_COMPAT_ZMK_BEHAVIOR_LAYER_TRANSITION))

DT_COMPAT_ZMK_BEHAVIOR_LAYER_MODIFIER := zmk,behavior-layer-modifier

config ZMK_BEHAVIOR_LAYER_MODIFIER
    bool
    default $(dt_compat_enabled,$(DT_COMPAT_ZMK_BEHAVIOR_LAYER_MODIFIER))

DT_COMPAT_ZMK_BEHAVIOR_ALPHA_REPEAT := zmk,behavior-alpha-repeat

config ZMK_BEHAVIOR_ALPHA_REPEAT
    bool
    default $(dt_compat_enabled,$(DT_COMPAT_ZMK_BEHAVIOR_ALPHA_REPEAT))
```

## config/modules/keymap-behaviors/dts/bindings/behaviors/zmk,behavior-alpha-repeat.yaml
```yaml
description: Repeat last unmodified or shifted alphabetic key

compatible: "zmk,behavior-alpha-repeat"

include: zero_param.yaml
```

## config/modules/keymap-behaviors/dts/bindings/behaviors/zmk,behavior-layer-transition.yaml
```yaml
description: Momentary transition between independently released layers

compatible: "zmk,behavior-layer-transition"

include: one_param.yaml

properties:
  parent-layer:
    type: int
    required: true
  child-layer:
    type: int
    required: true
  parent-overlay-layer:
    type: int
  child-overlay-layer:
    type: int
  parent-position:
    type: int
    required: true
  child-position:
    type: int
    required: true
```

## config/modules/keymap-behaviors/dts/bindings/misc/razen,vim-adaptive-guard.yaml
```yaml
description: Guard adaptive keys by editor mode
compatible: "razen,vim-adaptive-guard"
```

## config/modules/layer-chord/dts/bindings/behaviors/zmk,behavior-layer-chord.yaml
```yaml
description: Momentary layer chord with independently released layers

compatible: "zmk,behavior-layer-chord"

include: one_param.yaml

properties:
  parent-layer:
    type: int
    required: true
  child-layer:
    type: int
    required: true
  parent-overlay-layer:
    type: int
  child-overlay-layer:
    type: int
  parent-position:
    type: int
    required: true
  child-position:
    type: int
    required: true
```

## config/modules/layer-chord/dts/bindings/behaviors/zmk,behavior-layer-mod-chord.yaml
```yaml
description: Momentary layer and modifier chord with independent releases

compatible: "zmk,behavior-layer-mod-chord"

include: zero_param.yaml

properties:
  bindings:
    type: phandle-array
    required: true
  sticky-bindings:
    type: phandle-array
    specifier-space: binding
    required: true
  tapping-term-ms:
    type: int
    required: true
  layer:
    type: int
    required: true
  layer-position:
    type: int
    required: true
  modifier-positions:
    type: array
    required: true
  activation-layers:
    type: array
    required: true
  trigger-modifiers:
    type: int
    required: true
  combo-term-ms:
    type: int
    required: true
```
